## config/west.yml
```yaml
manifest:
  remotes:
    - name: zmkfirmware
      url-base: https://github.com/zmkfirmware
    - name: zzeneg
      url-base: https://github.com/zzeneg
    - name: srwi
      url-base: https://github.com/srwi
    - name: dhruvinsh
      url-base: https://github.com/dhruvinsh

  projects:
    - name: zephyr
      remote: zmkfirmware
      revision: v3.5.0+zmk-fixes
      clone-depth: 1
      import:
        name-blocklist:
          - ci-tools
          - hal_altera
          - hal_cypress
          - hal_infineon
          - hal_microchip
          - hal_nxp
          - hal_openisa
          - hal_silabs
          - hal_xtensa
          - hal_st
          - hal_ti
          - loramac-node
          - mcuboot
          - mcumgr
          - net-tools
          - openthread
          - edtt
          - trusted-firmware-m

    - name: zmk
      remote: zmkfirmware
      revision: v0.3
      clone-depth: 1
      import: app/west.yml

    - name: nanopb
      remote: zmkfirmware
      revision: 8c60555d6277a0360c876bd85d491fc4fb0cd74a
      clone-depth: 1
      path: modules/lib/nanopb

    - name: zmk-studio-messages
      remote: zmkfirmware
      revision: 6cb4c283e76209d59c45fbcb218800cd19e9339d
      clone-depth: 1
      path: modules/msgs/zmk-studio-messages

    - name: zmk-raw-hid
      remote: zzeneg
      revision: main
      clone-depth: 1

    - name: zmk-keypeek-layer-notifier
      remote: srwi
      revision: master
      clone-depth: 1

    - name: zmk-tri-state
      remote: dhruvinsh
      revision: main
      clone-depth: 1
      path: modules/zmk-tri-state

  self:
    path: config
```
